## conf/bblayers.conf
```bitbake
# LAYER_CONF_VERSION is increased each time build/conf/bblayers.conf
# changes incompatibly
LCONF_VERSION = "8"

BBPATH = "${TOPDIR}"
BBFILES ?= ""

BBLAYERS ?= " \
  /home/matt/src/openbmc/meta \
  /home/matt/src/openbmc/meta-poky \
  /home/matt/src/openbmc/meta-openembedded/meta-oe \
  /home/matt/src/openbmc/meta-openembedded/meta-networking \
  /home/matt/src/openbmc/meta-openembedded/meta-python \
  /home/matt/src/openbmc/meta-phosphor \
  /home/matt/src/openbmc/meta-aspeed \
  /home/matt/src/openbmc/meta-evb/meta-evb-aspeed/meta-evb-ast2600 \
  /home/matt/tmp/build/obmc-y2038/workspace \
  "
```
